## sources/6.1.y/drivers/net/wireless/realtek/rtl8188eu/Kconfig
```kconfig
config RTL8188EU
	tristate "Realtek RTL8188EU USB WiFi"
	depends on USB
	help
	  Say Y or M in case you want support for these drivers
```

## sources/6.1.y/drivers/net/wireless/realtek/rtl8812au/Kconfig
```kconfig
config 88XXAU
	tristate "Realtek RTL8812AU/RTL8814AU/RTL8821AU USB WiFi"
	depends on USB
	help
	  Help message of RTL8812AU/RTL8814AU/RTL8821AU
```
